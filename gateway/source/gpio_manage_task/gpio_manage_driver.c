/**
*********************************************************************************************************
*                                        multi_switch_control
*                                      (c) Copyright 2021-2031
*                                         All Rights Reserved
*
* @File    : 
* @By      : liwei
* @Version : V0.01
* 
*********************************************************************************************************
**/
/*
*********************************************************************************************************
Includes 
*********************************************************************************************************
*/
#include "user_type.h"
#include "gpio_manage_driver.h"
#include "gpio_manage_bsp_hc32f64.h"
/*
*********************************************************************************************************
Define
*********************************************************************************************************
*/
#define KEN_NUM 8
#define MAX_NUM 100
#define OFF_NUM 5
#define DELAY_NUM 2

/*
*********************************************************************************************************
Typedef
*********************************************************************************************************
*/
typedef struct key_frame_def
{
	u8 type;		
	u8 num;
	u8  current_status;
	u8  last_status;
	u8  read_status;
	u8 delay;
}key_frame_t;
/*
*********************************************************************************************************
Variables
*********************************************************************************************************
*/
key_frame_t key_manage[10];

/*
*********************************************************************************************************
Function 
*********************************************************************************************************
*/

/**
*********************************************************************************************************
* @名称	: 
* @描述	: 
*********************************************************************************************************
**/
void gpio_driver_init(void)
{
	gpio_bsp_init();
	for(u8 i = 0; i < KEN_NUM ; i++)
	{
		key_manage[i].current_status = 0xff;
		key_manage[i].last_status = 0xff;
		key_manage[i].read_status = 0xff;		
		key_manage[i].num = 0;	
		key_manage[i].type = 0xff;
	}
}
/**
*********************************************************************************************************
* @名称	: 
* @描述	: 
*********************************************************************************************************
**/
void  switch_driver_write(u8 cmd , u8 channel ,u8 value)
{
	switch(cmd)
	{
		/* 单灯控制*/
		case 0:
		{
			gpio_bsp_write(channel ,value);	
		}
		break;
		/* 全灯控制  1字节8个灯*/
		case 1:
		{
			for(u8 i=0; i < 8 ; i++)
				if((value & (0x01 << i )) != 0)
					gpio_bsp_write(i ,1);	
				else
					gpio_bsp_write(i ,0);
		}
		break;	
		default:
		break;
	}
}
/**
*********************************************************************************************************
* @名称	: 
* @描述	:  0 低电平  1  高电平
*********************************************************************************************************
**/
void button_scanf(void)
{
	/*按键扫描*/
	for(u8 i=0;i < KEN_NUM ; i++)
	{
		/*读取状态不变*/
		if(key_manage[i].read_status == gpio_bsp_read(i))
		{
			
			if(key_manage[i].num < 5)
				key_manage[i].num++;
			else
			{
				/*与按键最后状态比较*/
				if(key_manage[i].last_status != key_manage[i].read_status)
				{
					key_manage[i].num = 0;
					key_manage[i].last_status = key_manage[i].read_status;
					key_manage[i].type = key_manage[i].last_status;
				}			
			}			
		}
		else
		{
			/*等于当前读取状态*/
			key_manage[i].read_status = gpio_bsp_read(i);
			key_manage[i].num = 0;
		}	
	}		
}
/**
*********************************************************************************************************
* @名称	: 
* @描述	:  
*********************************************************************************************************
**/
u8 read_single(u8* buff)
{
	for(u8 i = 0;i < 8;i++)
	{
		/*状态更新后只发送一次*/
		if((key_manage[i].type != 0xff))
		{
			buff[0]=i;/*通道*/
			buff[1]=key_manage[i].type;/*类型*/
			/*清空*/
			key_manage[i].type=0xff;			
			return 1;			
		}
	}
	return 0;
}
/***********************************************END*****************************************************/

